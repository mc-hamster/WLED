#pragma once
#include <stddef.h>
#include <stdint.h>
#include <string.h>

// AI: below section was generated by an AI
namespace ble_api_bridge {
// Pure framing state shared by the firmware and native regression tests.
struct FrameAssembly {
  size_t expected = 0;
  size_t received = 0;
  bool active = false;
  bool ready = false;
  uint32_t started = 0;

  bool append(const uint8_t* data, size_t len, uint8_t* buffer, size_t capacity, uint32_t now) {
    if (ready || !buffer || !data || len == 0) return false;
    if (!active) {
      if (len < 2) return false;
      const size_t length = data[0] | (static_cast<uint16_t>(data[1]) << 8);
      if (!length || length > capacity || len - 2 > length) return false;
      expected = length;
      received = len - 2;
      active = true;
      memcpy(buffer, data + 2, received);
    } else {
      if (len > expected - received) return false;
      memcpy(buffer + received, data, len);
      received += len;
    }
    started = now;
    if (received == expected) { ready = true; active = false; }
    return true;
  }

  bool expired(uint32_t now, uint32_t timeout) const { return active && uint32_t(now - started) >= timeout; }
};
} // namespace ble_api_bridge
// AI: end
