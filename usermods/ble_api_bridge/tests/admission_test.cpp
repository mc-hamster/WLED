// AI: below section was generated by an AI
// Host fixture for the actual firmware callback definitions inserted by test_admission.py.
// Only NimBLE data access, disconnection requests, and the FreeRTOS queue are substituted.
#include <algorithm>
#include <array>
#include <atomic>
#include <cassert>
#include <cstdint>
#include <cstdio>
#include <cstring>
#include <vector>

#define DEBUG_PRINTF(...) ((void)0)
constexpr uint16_t BLE_HS_CONN_HANDLE_NONE = 0xffff;
constexpr uint16_t MAX_RESPONSE_CHUNK = 244;

struct NimBLEConnInfo {
  uint16_t connection;
  bool encrypted = true;
  bool authenticated = true;
  bool bonded = true;
  uint16_t getConnHandle() const { return connection; }
  bool isEncrypted() const { return encrypted; }
  bool isAuthenticated() const { return authenticated; }
  bool isBonded() const { return bonded; }
};

struct NimBLEServer {
  std::vector<uint16_t> rejected;
  void disconnect(uint16_t connection) { rejected.push_back(connection); }
};

struct NimBLECharacteristic {
  uint16_t handle;
  std::vector<uint8_t> value;
  uint16_t getHandle() const { return handle; }
  const std::vector<uint8_t>& getValue() const { return value; }
};

namespace ble_api_bridge {
class BleApiBridgeUsermod {
public:
  enum class EventType : uint8_t { Connected, Disconnected, Authenticated, Subscribed, Write, Confirmed };
  struct Event {
    EventType type;
    uint16_t connection;
    uint16_t handle;
    int status;
    uint16_t size;
    uint8_t data[MAX_RESPONSE_CHUNK];
  };
  std::atomic<bool> _acceptConnections{true};
  std::atomic<uint16_t> _callbackConnHandle{BLE_HS_CONN_HANDLE_NONE};
  NimBLEServer server;
  NimBLEServer* _server = &server;
  NimBLECharacteristic rx{12, {1, 0, 'x'}};
  NimBLECharacteristic tx{13, {}};
  NimBLECharacteristic live{14, {}};
  NimBLECharacteristic* _rx = &rx;
  NimBLECharacteristic* _tx = &tx;
  NimBLECharacteristic* _live = &live;
  std::vector<Event> events;

  void enqueue(const Event& event) { events.push_back(event); }
  bool acceptConnection(NimBLEConnInfo& info);
  void onConnect(NimBLEServer*, NimBLEConnInfo& info);
  void onDisconnect(NimBLEServer*, NimBLEConnInfo& info, int reason);
  void onAuthenticationComplete(NimBLEConnInfo& info);
  void onWrite(NimBLECharacteristic*, NimBLEConnInfo& info);
  void onSubscribe(NimBLECharacteristic*, NimBLEConnInfo& info, uint16_t value);
  void onStatus(NimBLECharacteristic*, NimBLEConnInfo& info, int status);
};
} // namespace ble_api_bridge

// The Python adapter writes this include from the checked-out production .cpp.
#include "admission_callbacks.inc"

using Bridge = ble_api_bridge::BleApiBridgeUsermod;
using Kind = Bridge::EventType;

static void deliver(Bridge& bridge, int callback, NimBLEConnInfo& peer) {
  switch (callback) {
    case 0: bridge.onConnect(&bridge.server, peer); break;
    case 1: bridge.onAuthenticationComplete(peer); break;
    case 2: bridge.onSubscribe(&bridge.tx, peer, 2); break;
    case 3: bridge.onWrite(&bridge.rx, peer); break;
    default: assert(false);
  }
}

static size_t connectedCount(const Bridge& bridge) {
  return std::count_if(bridge.events.begin(), bridge.events.end(),
                       [](const Bridge::Event& event) { return event.type == Kind::Connected; });
}

int main() {
  size_t permutations = 0;
  std::array<int, 4> order{0, 1, 2, 3};
  do {
    const auto write = std::find(order.begin(), order.end(), 3);
    // Auth and TX subscription must precede a request, but GAP CONNECT can occur anywhere.
    if (std::find(order.begin(), order.end(), 1) > write ||
        std::find(order.begin(), order.end(), 2) > write) continue;
    Bridge bridge;
    NimBLEConnInfo peer{7};
    for (int callback : order) deliver(bridge, callback, peer);
    assert(bridge.server.rejected.empty());
    assert(bridge.events.size() == 4);
    assert(connectedCount(bridge) == 1);
    assert(bridge.events.front().type == Kind::Connected);
    assert(bridge._callbackConnHandle.load() == peer.connection);
    size_t index = 1;
    for (int callback : order) {
      if (callback == 0) continue;
      const auto& event = bridge.events[index++];
      const Kind expected[] = {Kind::Connected, Kind::Authenticated, Kind::Subscribed, Kind::Write};
      assert(event.type == expected[callback] && event.connection == peer.connection);
      if (event.type == Kind::Authenticated) assert(event.status == 0);
      if (event.type == Kind::Subscribed) assert(event.handle == bridge.tx.handle && event.status == 2);
      if (event.type == Kind::Write) {
        assert(event.size == bridge.rx.value.size());
        assert(std::equal(bridge.rx.value.begin(), bridge.rx.value.end(), event.data));
      }
    }
    // The delayed callback must not reset already-authenticated state through another Connected event.
    bridge.onConnect(&bridge.server, peer);
    bridge.onSubscribe(&bridge.live, peer, 2);
    assert(connectedCount(bridge) == 1);
    assert(bridge.events.back().handle == bridge.live.handle);
    ++permutations;
  } while (std::next_permutation(order.begin(), order.end()));
  assert(permutations == 8);

  for (int first = 0; first < 4; ++first) {
    Bridge bridge;
    NimBLEConnInfo owner{7}, intruder{11};
    deliver(bridge, first, owner);
    const size_t acceptedEvents = bridge.events.size();
    for (int callback = 0; callback < 4; ++callback) deliver(bridge, callback, intruder);
    assert(bridge.events.size() == acceptedEvents);
    assert(bridge.server.rejected == std::vector<uint16_t>({11, 11, 11, 11}));
    assert(bridge._callbackConnHandle.load() == owner.connection);

    bridge.onDisconnect(&bridge.server, intruder, 19);
    assert(bridge._callbackConnHandle.load() == owner.connection);
    const size_t connected = connectedCount(bridge);
    bridge.onConnect(&bridge.server, owner);
    assert(connectedCount(bridge) == connected);

    // NimBLE 2.5.1 supplies an empty connection description to onStatus.
    NimBLEConnInfo empty{0};
    bridge.onStatus(&bridge.tx, empty, 321);
    assert(bridge.events.back().type == Kind::Confirmed);
    assert(bridge.events.back().connection == owner.connection);
    assert(bridge.events.back().status == 321);

    bridge.onDisconnect(&bridge.server, owner, 19);
    assert(bridge._callbackConnHandle.load() == BLE_HS_CONN_HANDLE_NONE);
    const size_t disconnectedEvents = bridge.events.size();
    bridge.onStatus(&bridge.tx, empty, 321);
    assert(bridge.events.size() == disconnectedEvents);
    // Handles can be reused by the stack after a real disconnect.
    bridge.onAuthenticationComplete(owner);
    assert(connectedCount(bridge) == connected + 1);
    assert(bridge.events[disconnectedEvents].type == Kind::Connected);
    assert(bridge.events[disconnectedEvents + 1].type == Kind::Authenticated);
  }

  for (int first = 0; first < 4; ++first) {
    Bridge bridge;
    NimBLEConnInfo peer{7};
    bridge._acceptConnections = false;
    deliver(bridge, first, peer);
    assert(bridge.events.empty());
    assert(bridge._callbackConnHandle.load() == BLE_HS_CONN_HANDLE_NONE);
    assert(bridge.server.rejected == std::vector<uint16_t>({7}));
  }

  // First-callback admission must not weaken encrypted/authenticated/bonded RX checks.
  for (int missing = 0; missing < 3; ++missing) {
    Bridge bridge;
    NimBLEConnInfo peer{7};
    if (missing == 0) peer.encrypted = false;
    if (missing == 1) peer.authenticated = false;
    if (missing == 2) peer.bonded = false;
    bridge.onWrite(&bridge.rx, peer);
    assert(bridge.events.empty());
    assert(bridge.server.rejected == std::vector<uint16_t>({7}));
    bridge.onAuthenticationComplete(peer);
    assert(bridge.events.front().type == Kind::Connected);
    assert(bridge.events.back().type == Kind::Authenticated && bridge.events.back().status != 0);
    assert(bridge.server.rejected.size() == 2);
  }
  {
    Bridge bridge;
    NimBLEConnInfo peer{7};
    bridge.onWrite(&bridge.tx, peer);
    assert(bridge.events.empty());
    assert(bridge.server.rejected == std::vector<uint16_t>({7}));
  }
  std::printf("Passed %zu callback-order permutations, first-callback admission, competing peers, "
              "disconnect/reuse, confirmation identity and RX security checks.\n", permutations);
}
// AI: end
