// AI: below section was generated by an AI
// Run actual callback, event, loop, framing and indication scheduler definitions on
// the host. Radio/FreeRTOS primitives and the JSON application dispatcher are fakes.
#include <algorithm>
#include <atomic>
#include <cassert>
#include <cstdint>
#include <cstdio>
#include <cstring>
#include <memory>
#include <string>
#include <vector>
#include "../ble_bridge_protocol.h"

#define DEBUG_PRINTF(...) ((void)0)
constexpr uint16_t BLE_HS_CONN_HANDLE_NONE = 0xffff;
constexpr int BLE_HS_EDONE = 14;
constexpr int pdTRUE = 1;
constexpr uint16_t MAX_RESPONSE_CHUNK = 244;
constexpr uint32_t DEFAULT_REQUEST_TIMEOUT = 10000;
constexpr uint32_t PAIRING_TIMEOUT = 120000;
constexpr uint32_t INDICATION_TIMEOUT = 10000;
constexpr uint32_t LIVE_PUSH_DEBOUNCE_MS = 150;
static uint32_t now = 100;
static uint32_t millis() { return now; }

template <typename T> int xQueueSend(std::vector<T>* queue, const T* event, int) {
  queue->push_back(*event);
  return pdTRUE;
}
template <typename T> int xQueueReceive(std::vector<T>* queue, T* event, int) {
  if (queue->empty()) return 0;
  *event = queue->front();
  queue->erase(queue->begin());
  return pdTRUE;
}
template <typename T> void xQueueReset(std::vector<T>* queue) { queue->clear(); }

struct NimBLEConnInfo {
  uint16_t connection;
  bool encrypted = true;
  bool authenticated = true;
  bool bonded = true;
  uint16_t getConnHandle() const { return connection; }
  bool isEncrypted() const { return encrypted; }
  bool isAuthenticated() const { return authenticated; }
  bool isBonded() const { return bonded; }
};
struct NimBLEServer {
  std::vector<uint16_t> rejected;
  void disconnect(uint16_t connection) { rejected.push_back(connection); }
  uint16_t getPeerMTU(uint16_t) { return 247; }
};
struct NimBLECharacteristic {
  uint16_t handle;
  std::vector<uint8_t> value;
  std::vector<std::vector<uint8_t>> packets;
  uint16_t getHandle() const { return handle; }
  const std::vector<uint8_t>& getValue() const { return value; }
  bool indicate(const uint8_t* data, size_t size, uint16_t) {
    packets.emplace_back(data, data + size);
    return true;
  }
};
struct Advertising { void stop() {} };
struct NimBLEDevice {
  static Advertising* getAdvertising() { static Advertising advertising; return &advertising; }
  static void setDeviceName(const char*) {}
};

namespace ble_api_bridge {
class BleApiBridgeUsermod {
public:
  enum class EventType : uint8_t { Connected, Disconnected, Authenticated, Subscribed, Write, Confirmed };
  struct Event {
    EventType type;
    uint16_t connection;
    uint16_t handle;
    int status;
    uint16_t size;
    uint8_t data[MAX_RESPONSE_CHUNK];
  };
  struct ResponseState {
    std::string payload;
    size_t offset = 0;
    NimBLECharacteristic* characteristic = nullptr;
    bool active = false;
    bool firstChunk = true;
    bool awaitingConfirmation = false;
    uint32_t sentAt = 0;
  } _response;
  FrameAssembly _request;
  bool _setupDone = true;
  bool _enabled = true;
  bool _secure = false;
  bool _indicationsEnabled = false;
  bool _liveSessionReady = false;
  bool _livePushPending = false;
  bool _restartBlePending = false;
  std::atomic<bool> _bleInitialized{true};
  std::atomic<bool> _bleConnected{false};
  std::atomic<bool> _configChanged{false};
  std::atomic<bool> _stateChanged{false};
  std::atomic<bool> _queueOverflow{false};
  std::atomic<bool> _liveUpdatesEnabled{false};
  std::atomic<bool> _acceptConnections{true};
  std::atomic<uint16_t> _callbackConnHandle{BLE_HS_CONN_HANDLE_NONE};
  uint16_t _activeConnHandle = BLE_HS_CONN_HANDLE_NONE;
  uint16_t _maxRequestBytes = 4096;
  uint32_t _livePushDueAt = 0;
  uint32_t _connectedAt = 0;
  uint32_t _nextAdvertiseAt = 0;
  std::string _deviceName = "fixture";
  std::unique_ptr<uint8_t[]> _requestBuffer{new uint8_t[4096]};
  NimBLEServer server;
  NimBLEServer* _server = &server;
  NimBLECharacteristic rx{12, {}, {}};
  NimBLECharacteristic tx{13, {}, {}};
  NimBLECharacteristic live{14, {}, {}};
  NimBLECharacteristic* _rx = &rx;
  NimBLECharacteristic* _tx = &tx;
  NimBLECharacteristic* _live = &live;
  std::vector<Event> events;
  std::vector<Event>* _events = &events;
  size_t dispatches = 0;
  size_t liveSnapshots = 0;
  bool readyDuringFirstDispatch = false;
  bool failDispatch = false;
  std::string lastError;

  void applyConfig() {}
  bool initBleStack() { _bleInitialized = true; return true; }
  bool startAdvertising() { return true; }
  void setLastError(const char* error) { lastError = error; }
  void processBleRequest() {
    assert(_request.ready && _secure && _indicationsEnabled);
    if (dispatches++ == 0) readyDuringFirstDispatch = _liveSessionReady;
    if (failDispatch) { failConnection("fixture dispatcher failure"); return; }
    const std::string text(reinterpret_cast<const char*>(_requestBuffer.get()), _request.received);
    clearRequestAssembly();
    // The readiness contract is framing/authentication, independent of HTTP status.
    _response.payload = text == "GET /json/info" ? "200\napplication/json\n{}" : "400\napplication/json\n{}";
    _response.payload.append(300, ' '); // Force two actual scheduler packets/confirmations.
    _response.characteristic = _tx;
    _response.active = true;
  }
  bool queueLiveStatePush() {
    assert(_liveUpdatesEnabled);
    ++liveSnapshots;
    _response.payload = "{\"state\":{},\"info\":{}}";
    _response.characteristic = _live;
    _response.active = true;
    return true;
  }
  void loop();
  void enqueue(const Event& event);
  bool acceptConnection(NimBLEConnInfo& info);
  void onConnect(NimBLEServer*, NimBLEConnInfo& info);
  void onDisconnect(NimBLEServer*, NimBLEConnInfo& info, int reason);
  void onAuthenticationComplete(NimBLEConnInfo& info);
  void onWrite(NimBLECharacteristic*, NimBLEConnInfo& info);
  void onSubscribe(NimBLECharacteristic*, NimBLEConnInfo& info, uint16_t value);
  void onStatus(NimBLECharacteristic*, NimBLEConnInfo& info, int status);
  void handleEvents();
  void resetConnection();
  void failConnection(const char* message);
  void stopBle();
  void refreshBleConfiguration();
  bool processWriteChunk(const uint8_t* data, size_t size);
  void sendNextResponseChunk();
  void clearRequestAssembly();
  void clearResponse();
};
} // namespace ble_api_bridge

#include "live_readiness_methods.inc"
using Bridge = ble_api_bridge::BleApiBridgeUsermod;

static void restoreSubscriptions(Bridge& bridge, NimBLEConnInfo& peer) {
  now = 100;
  bridge.onSubscribe(&bridge.live, peer, 2);
  bridge.onSubscribe(&bridge.tx, peer, 2);
  bridge.onAuthenticationComplete(peer);
  bridge.onConnect(&bridge.server, peer); // Delayed GAP CONNECT must not reset subscriptions.
  bridge.loop();
  now += LIVE_PUSH_DEBOUNCE_MS + 1;
  bridge._stateChanged = true;
  bridge.loop();
  assert(bridge._bleConnected && bridge._secure && bridge._liveUpdatesEnabled);
  assert(!bridge._liveSessionReady && bridge._livePushPending);
  assert(bridge.liveSnapshots == 0 && bridge.live.packets.empty() && bridge.tx.packets.empty());
}
static std::vector<uint8_t> frame(const std::string& text) {
  std::vector<uint8_t> bytes{static_cast<uint8_t>(text.size()), static_cast<uint8_t>(text.size() >> 8)};
  bytes.insert(bytes.end(), text.begin(), text.end());
  return bytes;
}
static void write(Bridge& bridge, NimBLEConnInfo& peer, const std::vector<uint8_t>& bytes) {
  bridge.rx.value = bytes;
  bridge.onWrite(&bridge.rx, peer);
  bridge.loop();
}
static void confirm(Bridge& bridge, NimBLECharacteristic& characteristic) {
  NimBLEConnInfo empty{0}; // Matches pinned NimBLE's onStatus callback behavior.
  bridge.onStatus(&characteristic, empty, BLE_HS_EDONE);
  bridge.loop();
}
static void verifyFirstResponseThenLive(Bridge& bridge) {
  assert(bridge.dispatches == 1 && !bridge.readyDuringFirstDispatch && bridge._liveSessionReady);
  assert(bridge.tx.packets.size() == 1 && bridge.live.packets.empty());
  bridge.loop(); // No second packet or LIVE before first TX confirmation.
  assert(bridge.tx.packets.size() == 1 && bridge.live.packets.empty());
  confirm(bridge, bridge.tx);
  assert(bridge.tx.packets.size() == 2 && bridge.live.packets.empty());
  bridge.loop(); // Final TX packet also must be confirmed before LIVE.
  assert(bridge.live.packets.empty());
  confirm(bridge, bridge.tx);
  assert(bridge.liveSnapshots == 1 && bridge.live.packets.size() == 1);
  confirm(bridge, bridge.live);
  assert(!bridge._response.active);
}

int main() {
  NimBLEConnInfo peer{7};
  {
    Bridge bridge;
    restoreSubscriptions(bridge, peer);
    for (int step = 0; step < 5; ++step) { now += 500; bridge.loop(); }
    assert(!bridge._liveSessionReady && bridge.live.packets.empty());
    write(bridge, peer, frame("GET /json/info"));
    verifyFirstResponseThenLive(bridge);
    bridge.onDisconnect(&bridge.server, peer, 19);
    bridge.loop();
    assert(!bridge._liveSessionReady && !bridge._bleConnected);
    bridge.liveSnapshots = 0;
    bridge.tx.packets.clear();
    bridge.live.packets.clear();
    restoreSubscriptions(bridge, peer); // Reused handle requires its own application request.
  }
  {
    Bridge bridge;
    restoreSubscriptions(bridge, peer);
    const auto bytes = frame("GET /json/info");
    write(bridge, peer, {bytes.begin(), bytes.begin() + 5});
    assert(bridge._request.active && !bridge._liveSessionReady && bridge.dispatches == 0);
    now += 1000;
    bridge.loop();
    assert(bridge.live.packets.empty());
    write(bridge, peer, {bytes.begin() + 5, bytes.end()});
    verifyFirstResponseThenLive(bridge);
  }
  {
    Bridge bridge;
    restoreSubscriptions(bridge, peer);
    write(bridge, peer, frame("malformed application request"));
    assert(bridge._response.payload.rfind("400\n", 0) == 0);
    verifyFirstResponseThenLive(bridge); // A400 TX response still proves application readiness.
  }
  for (const auto& invalid : std::vector<std::vector<uint8_t>>{{0, 0}, {1, 0, 'x', 'y'}, {1}}) {
    Bridge bridge;
    restoreSubscriptions(bridge, peer);
    write(bridge, peer, invalid);
    assert(bridge.dispatches == 0 && !bridge._liveSessionReady && !bridge._bleConnected);
    assert(bridge.live.packets.empty() && !bridge.server.rejected.empty());
  }
  {
    Bridge bridge;
    restoreSubscriptions(bridge, peer);
    bridge.failDispatch = true;
    write(bridge, peer, frame("GET /json/info"));
    assert(bridge.dispatches == 1 && !bridge._liveSessionReady && !bridge._bleConnected);
    assert(bridge.live.packets.empty());
  }
  {
    Bridge bridge;
    restoreSubscriptions(bridge, peer);
    bridge.onSubscribe(&bridge.tx, peer, 0);
    write(bridge, peer, frame("GET /json/info"));
    assert(!bridge._liveSessionReady && !bridge._bleConnected && bridge.dispatches == 0);
  }
  for (int missing = 0; missing < 3; ++missing) {
    Bridge bridge;
    restoreSubscriptions(bridge, peer);
    NimBLEConnInfo insecure{7};
    if (missing == 0) insecure.encrypted = false;
    if (missing == 1) insecure.authenticated = false;
    if (missing == 2) insecure.bonded = false;
    write(bridge, insecure, frame("GET /json/info"));
    assert(!bridge._liveSessionReady && bridge.dispatches == 0 && bridge.live.packets.empty());
    assert(!bridge.server.rejected.empty());
  }
  for (bool disabled : {false, true}) {
    Bridge bridge;
    restoreSubscriptions(bridge, peer);
    write(bridge, peer, frame("GET /json/info"));
    verifyFirstResponseThenLive(bridge);
    if (disabled) bridge._enabled = false;
    else bridge._restartBlePending = true;
    bridge.loop();
    assert(!bridge._liveSessionReady && !bridge._bleConnected && !bridge._livePushPending);
    assert(bridge.live.packets.size() == 1);
  }
  std::puts("Passed LIVE readiness: restored CCCDs, complete/partial/bad frames, authenticated RX, "
            "application errors, final TX confirmation, dispatch failure, disconnect/reuse and config reset.");
}
// AI: end
