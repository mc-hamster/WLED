#include "ble_api_bridge.h"
#include <mbedtls/base64.h>
#include <mbedtls/sha256.h>
#include <algorithm>
#include <memory>

// AI: below section was generated by an AI
namespace ble_api_bridge {
namespace {
// These methods run on WLED's 8 KiB loop task. Nested read/hash/encoding calls
// must not put kilobyte scratch arrays on its stack. Prefer PSRAM when present,
// and return an error if the checked allocation cannot be satisfied.
struct ScratchDeleter {
  void operator()(uint8_t* bytes) const { p_free(bytes); }
};
using ScratchBuffer = std::unique_ptr<uint8_t, ScratchDeleter>;
ScratchBuffer scratchBuffer(size_t size) {
  return ScratchBuffer(static_cast<uint8_t*>(p_malloc(std::max<size_t>(1, size))));
}

String digestHex(const uint8_t* bytes) {
  char text[65];
  constexpr char digits[] = "0123456789abcdef";
  for (size_t i = 0; i < 32; ++i) { text[2*i] = digits[bytes[i] >> 4]; text[2*i+1] = digits[bytes[i] & 15]; }
  text[64] = 0;
  return String(text);
}

bool fileDigest(File& file, String& digest) {
  if (!file || !file.seek(0)) return false;
  auto buffer = scratchBuffer(MAX_TRANSFER_CHUNK);
  if (!buffer) return false;
  mbedtls_sha256_context context;
  mbedtls_sha256_init(&context);
  bool valid = mbedtls_sha256_starts(&context, 0) == 0;
  uint8_t result[32];
  size_t remaining = file.size();
  while (valid && remaining) {
    size_t count = file.read(buffer.get(), std::min(remaining, MAX_TRANSFER_CHUNK));
    valid = count > 0 && mbedtls_sha256_update(&context, buffer.get(), count) == 0;
    remaining -= count;
    yield();
  }
  valid = valid && mbedtls_sha256_finish(&context, result) == 0;
  mbedtls_sha256_free(&context);
  if (valid) digest = digestHex(result);
  return valid;
}

String textDigest(const String& body) {
  uint8_t digest[32];
  if (mbedtls_sha256(reinterpret_cast<const uint8_t*>(body.c_str()), body.length(), digest, 0)) return String();
  return digestHex(digest);
}

bool encodeBytes(const uint8_t* bytes, size_t size, String& encoded) {
  if (size > MAX_TRANSFER_CHUNK) return false;
  const size_t capacity = 4 * ((size + 2) / 3) + 1;
  auto buffer = scratchBuffer(capacity);
  if (!buffer) return false;
  size_t count = 0;
  if (mbedtls_base64_encode(buffer.get(), capacity, &count, bytes, size)) return false;
  encoded = "";
  return encoded.concat(reinterpret_cast<const char*>(buffer.get()), count) && encoded.length() == count;
}

// Reject whitespace, embedded padding, and oversize data before decoding.
bool decodeBytes(const char* text, uint8_t* output, size_t capacity, size_t& written) {
  return decodeBase64(text, output, capacity, written);
}

bool publicFile(const String& path) {
  return path == F("/presets.json") || (path.startsWith(F("/palette")) && path.endsWith(F(".json")));
}

bool stagedRoute(const String& path) {
  return path == F("/json") || path == F("/json/state") || path == F("/json/si") || path == F("/json/cfg")
    || path == F("/settings/wifi") || path == F("/settings/leds") || path == F("/settings/ui")
    || path == F("/settings/sync") || path == F("/settings/time") || path == F("/settings/sec")
    || path == F("/settings/dmx") || path == F("/settings/um") || path == F("/settings/2D");
}

// Reserved WLED files must have the expected root shape. Configuration restores
// additionally require the revision, identity, and LED hardware backup fields.
bool validReservedFile(const String& path) {
  if (path != F("/cfg.json") && path != F("/presets.json")) return true;
  File file = WLED_FS.open(TRANSFER_FILE, "r");
  if (!file) return false;
  int first;
  do { first = file.read(); } while (first == ' ' || first == '\n' || first == '\r' || first == '\t');
  if (first != '{') return false;
  if (path == F("/presets.json")) return true;
  file.seek(0);
  DynamicJsonDocument filter(256);
  filter["rev"] = true;
  filter["id"]["name"] = true;
  filter["hw"]["led"]["total"] = true;
  DynamicJsonDocument document(768);
  if (filter.overflowed()) return false;
  if (deserializeJson(document, file, DeserializationOption::Filter(filter))) return false;
  JsonArray revision = document["rev"].as<JsonArray>();
  return revision.size() == 2 && revision[0].is<unsigned>() && revision[1].is<unsigned>()
    && document["id"]["name"].is<const char*>() && document["hw"]["led"]["total"].is<unsigned>();
}
} // namespace

void BleApiBridgeUsermod::cancelTransfer() {
  if (_transfer.file) _transfer.file.close();
  if (!_transfer.id.isEmpty()) WLED_FS.remove(TRANSFER_FILE);
  _transfer = {};
}

// A file read keeps no filesystem handle or flash copy between chunks. SHA-256
// binds the first and final version; clients also verify the reconstructed bytes.
bool BleApiBridgeUsermod::dispatchFileRead(const String& body) {
  DynamicJsonDocument input(1024);
  if (deserializeJson(input, body)) return queueErrorResponse(400, F("invalid file read"));
  String path = input["path"] | "";
  if (!validFilePath(path.c_str())) return queueErrorResponse(403, F("file is not accessible"));
  if (!publicFile(path) && !settingsAuthorized()) return queueErrorResponse(401, F("settings PIN required"));
  if (!input["offset"].isNull() && !input["offset"].is<uint32_t>()) return queueErrorResponse(400, F("invalid read offset"));
  size_t offset = input["offset"] | 0U;
  size_t length = input["length"] | static_cast<uint32_t>(transferChunkSize());
  if (!length || length > transferChunkSize()) return queueErrorResponse(400, F("invalid read length"));
  const String expectedRevision = input["revision"] | "";
  if (offset && !validDigest(expectedRevision.c_str())) return queueErrorResponse(400, F("a read revision is required"));
  String inlineContent, revision;
  size_t totalSize;
  File file;
  if (path == F("/cfg.json")) {
    if (!buildJsonBody(F("/json/cfg"), inlineContent)) return queueErrorResponse(503, F("configuration unavailable"));
    totalSize = inlineContent.length();
    revision = textDigest(inlineContent);
    if (offset && revision != expectedRevision) return queueErrorResponse(409, F("configuration changed while reading"));
  } else {
    file = WLED_FS.open(path, "r");
    if (!file || file.isDirectory()) return queueErrorResponse(404, F("file not found"));
    totalSize = file.size();
    if (!offset) {
      if (!fileDigest(file, revision)) return queueErrorResponse(500, F("file could not be read"));
    } else revision = expectedRevision;
  }
  if (offset > totalSize) return queueErrorResponse(409, F("file size changed while reading"));
  const size_t count = std::min(length, totalSize - offset);
  auto bytes = scratchBuffer(count);
  if (!bytes) return queueErrorResponse(503, F("file read buffer unavailable"));
  if (path == F("/cfg.json")) {
    memcpy(bytes.get(), inlineContent.c_str() + offset, count);
  } else {
    if (!file.seek(offset) || file.read(bytes.get(), count) != count)
      return queueErrorResponse(409, F("file changed while reading"));
    if (offset + count == totalSize) {
      String finalRevision;
      if (!fileDigest(file, finalRevision) || finalRevision != revision)
        return queueErrorResponse(409, F("file changed while reading"));
    }
  }
  String encoded;
  if (!encodeBytes(bytes.get(), count, encoded)) return queueErrorResponse(503, F("file encoding buffer unavailable"));
  DynamicJsonDocument output(2304);
  output["success"] = true;
  output["path"] = path;
  output["size"] = totalSize;
  output["offset"] = offset;
  output["next"] = offset + count;
  output["eof"] = offset + count == totalSize;
  output["revision"] = revision;
  output["data"] = encoded;
  return queueDocument(output);
}

bool BleApiBridgeUsermod::dispatchTransfer(const String& body, bool request) {
  DynamicJsonDocument input(_maxRequestBytes + 768);
  if (deserializeJson(input, body) || !input.is<JsonObject>()) return queueErrorResponse(400, F("invalid transfer request"));
  const String operation = input["op"] | "";
  if (!request && operation == "read") return dispatchFileRead(body);
  // Large lighting JSON requests need only the authenticated Bluetooth bond.
  // Every filesystem write and every settings/config request additionally needs PIN authorization.
  const String requestedPath = input["path"] | "";
  bool stateRequest = request && ((operation == "begin" && (requestedPath == "/json" || requestedPath == "/json/state" || requestedPath == "/json/si"))
    || (_transfer.request && (_transfer.path == "/json" || _transfer.path == "/json/state" || _transfer.path == "/json/si")));
  if (!stateRequest && !settingsAuthorized()) return queueErrorResponse(401, F("settings PIN required"));

  if (!request && operation == "list") {
    if (!input["cursor"].isNull() && !input["cursor"].is<uint32_t>()) return queueErrorResponse(400, F("invalid file cursor"));
    size_t cursor = input["cursor"] | 0U;
    size_t limit = std::min<size_t>(input["limit"] | 16U, 16);
    if (!limit) return queueErrorResponse(400, F("invalid file page size"));
    DynamicJsonDocument output(6144);
    JsonArray files = output.createNestedArray("files");
    File directory = WLED_FS.open("/", "r");
    size_t index = 0;
    bool more = false;
    for (File file = directory.openNextFile(); file; file = directory.openNextFile()) {
      String path = file.name();
      if (!path.startsWith("/")) path = '/' + path;
      if (!validFilePath(path.c_str()) || file.isDirectory()) continue;
      if (index++ < cursor) continue;
      if (files.size() >= limit) { more = true; break; }
      JsonObject entry = files.createNestedObject();
      entry["name"] = path;
      entry["size"] = file.size();
    }
    if (more) output["next"] = cursor + files.size();
    else output["next"] = nullptr;
    return queueDocument(output);
  }
  if (!request && operation == "delete") {
    if (!validFilePath(requestedPath.c_str())) return queueErrorResponse(403, F("file is not accessible"));
    if (!WLED_FS.exists(requestedPath)) return queueErrorResponse(404, F("file not found"));
    if (!WLED_FS.remove(requestedPath)) return queueErrorResponse(507, F("file could not be deleted"));
    if (requestedPath.startsWith(F("/palette")) && requestedPath.endsWith(F(".json"))) loadCustomPalettes();
    if (requestedPath == getPresetsFileName()) presetsModifiedTime = toki.second();
    cacheInvalidate++;
    updateFSInfo();
    return queueResponse(200, "application/json", buildSuccessEnvelope());
  }
  if (operation == "begin") {
    if (!_transfer.id.isEmpty()) return queueErrorResponse(409, F("another transfer is active"));
    if (!input["size"].is<uint32_t>()) return queueErrorResponse(400, F("invalid transfer size"));
    size_t size = input["size"].as<uint32_t>();
    const char* digest = input["sha256"] | "";
    if (!validDigest(digest)) return queueErrorResponse(400, F("invalid SHA-256"));
    if ((request && (!stagedRoute(requestedPath) || strcmp(input["method"] | "", "POST") || size > MAX_STAGED_REQUEST))
        || (!request && !validFilePath(requestedPath.c_str()))) return queueErrorResponse(400, F("invalid transfer destination"));
    const String contentType = input["contentType"] | "application/json";
    if (request && ((requestedPath.startsWith("/settings/") && contentType != "application/x-www-form-urlencoded")
        || (requestedPath.startsWith("/json") && !contentType.startsWith("application/json"))))
      return queueErrorResponse(415, F("unsupported staged content type"));
    updateFSInfo();
    if (getFsBytesTotal() < getFsBytesUsed() + 4096 || size > getFsBytesTotal() - getFsBytesUsed() - 4096)
      return queueErrorResponse(507, F("not enough space for a safe transfer"));
    _transfer.file = WLED_FS.open(TRANSFER_FILE, "w");
    if (!_transfer.file) return queueErrorResponse(507, F("cannot start transfer"));
    char id[9];
    snprintf(id, sizeof(id), "%08lx", static_cast<unsigned long>(esp_random()));
    _transfer.id = id;
    _transfer.path = requestedPath;
    _transfer.size = size;
    _transfer.digest = digest;
    _transfer.contentType = contentType;
    _transfer.request = request;
    _transfer.touched = millis();
    StaticJsonDocument<192> output;
    output["id"] = _transfer.id;
    output["maxChunk"] = transferChunkSize();
    output["next"] = 0;
    return queueDocument(output);
  }
  const String id = input["id"] | "";
  if (id.isEmpty() || id != _transfer.id || request != _transfer.request) return queueErrorResponse(409, F("transfer expired or does not exist"));
  _transfer.touched = millis();
  if (operation == "abort") {
    cancelTransfer();
    return queueResponse(200, "application/json", buildSuccessEnvelope());
  }
  if (operation == "write") {
    if (!input["offset"].is<uint32_t>()) return queueErrorResponse(400, F("invalid chunk offset"));
    const size_t offset = input["offset"].as<uint32_t>();
    auto bytes = scratchBuffer(transferChunkSize());
    if (!bytes) return queueErrorResponse(503, F("file write buffer unavailable"));
    size_t count = 0;
    if (!decodeBytes(input["data"], bytes.get(), transferChunkSize(), count) || !count
        || !validTransferRange(offset, count, _transfer.offset, _transfer.size)) return queueErrorResponse(400, F("invalid or out-of-order chunk"));
    if (_transfer.file.write(bytes.get(), count) != count) { cancelTransfer(); return queueErrorResponse(507, F("transfer write failed")); }
    _transfer.offset += count;
    StaticJsonDocument<128> output;
    output["id"] = id;
    output["next"] = _transfer.offset;
    return queueDocument(output);
  }
  if (operation != "commit") return queueErrorResponse(400, F("unknown transfer operation"));
  if (!request && ((_transfer.path == F("/cfg.json") && (configNeedsWrite || doInitBusses))
      || (_transfer.path == F("/presets.json") && presetNeedsSaving())))
    return queueErrorResponse(409, F("a device save is in progress; retry commit"));
  if (_transfer.offset != _transfer.size) return queueErrorResponse(409, F("transfer is incomplete"));
  _transfer.file.flush();
  _transfer.file.close();
  _transfer.file = WLED_FS.open(TRANSFER_FILE, "r");
  String digest;
  if (!_transfer.file || _transfer.file.size() != _transfer.size || !fileDigest(_transfer.file, digest) || digest != _transfer.digest) {
    cancelTransfer();
    return queueErrorResponse(422, F("transfer checksum did not match"));
  }
  if (request) {
    _transfer.file.seek(0);
    bool result;
    if (_transfer.path.startsWith("/settings/")) result = dispatchSettings(_transfer.path, String(), &_transfer.file);
    else result = dispatchJson(String(), &_transfer.file, _transfer.path == F("/json/cfg"));
    cancelTransfer();
    return result;
  }
  _transfer.file.close();
  if ((_transfer.path.endsWith(F(".json")) && !validateJsonFile(TRANSFER_FILE)) || !validReservedFile(_transfer.path)) {
    cancelTransfer();
    return queueErrorResponse(422, F("JSON file is invalid"));
  }
  // LittleFS rename replaces the destination atomically. The old file survives
  // interruption until this last step; no remove(destination) window is used.
  if (!WLED_FS.rename(TRANSFER_FILE, _transfer.path)) {
    cancelTransfer();
    return queueErrorResponse(507, F("file could not be committed"));
  }
  const String path = _transfer.path;
  const size_t size = _transfer.size;
  _transfer = {};
  if (path == getPresetsFileName()) presetsModifiedTime = toki.second();
  if (path.startsWith(F("/palette")) && path.endsWith(F(".json"))) loadCustomPalettes();
  cacheInvalidate++;
  updateFSInfo();
  StaticJsonDocument<384> output;
  output["success"] = true;
  output["saved"] = true;
  output["size"] = size;
  output["sha256"] = digest;
  output["reboot"] = path == F("/cfg.json");
  if (path == F("/cfg.json")) _rebootAfterResponse = true;
  return queueDocument(output);
}

// Use the same DDP decoder as Wi-Fi pixel tools, with the same 1428-byte packet
// budget. Reliable BLE requests provide back-pressure instead of queuing frames.
bool BleApiBridgeUsermod::dispatchDDP(const String& body) {
  DynamicJsonDocument input(2560);
  if (deserializeJson(input, body)) return queueErrorResponse(400, F("invalid pixel frame"));
  constexpr size_t maxPacketSize = 1428;
  auto packet = scratchBuffer(maxPacketSize);
  if (!packet) return queueErrorResponse(503, F("pixel buffer unavailable"));
  size_t count = 0;
  if (!decodeBytes(input["data"], packet.get(), maxPacketSize, count) || count < 11 || packet.get()[0] != 0x02)
    return queueErrorResponse(400, F("invalid DDP frame"));
  const size_t payloadSize = (static_cast<size_t>(packet.get()[9]) << 8) | packet.get()[10];
  if (payloadSize != count - 11 || packet.get()[3] != 0x0b || payloadSize % 3)
    return queueErrorResponse(400, F("invalid DDP pixel data"));
  handleE131Packet(reinterpret_cast<e131_packet_t*>(packet.get() + 1), IPAddress(0, 0, 0, 0), P_DDP, count - 1);
  return queueResponse(200, "application/json", buildSuccessEnvelope());
}
} // namespace ble_api_bridge
// AI: end
